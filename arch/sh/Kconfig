## arch/sh/boards/mach-b2039/Kconfig
```kconfig
if SH_ST_B2039

menu "B2039: STxH207-HVK board options"

choice
	prompt "B2039: Internal Ethernet PHY"
	default STM_B2039_INT_PHY_IC101G
	help
	  The STxH207 can have an Ethernet PHY mounted alongside the
	  SoC inside the package. Use this option to select which PHY,
	  if any, is present in the device being used.

config STM_B2039_INT_PHY_NONE
	bool "None"

config STM_B2039_INT_PHY_IC101A
	bool "IC+101A"
	help
	  Select this option if using an STxH207 which has an IC+101A
	  Ethernet PHY mounted alongside the SoC inside the package.

config STM_B2039_INT_PHY_IC101G
	bool "IC+101G"
	help
	  Select this option if using an STxH207 which has an IC+101G
	  Ethernet PHY mounted alongside the SoC inside the package.

endchoice

choice
	prompt "B2039: Internal PHY interface"
	default STM_B2039_IC101_MII
	depends on !STM_B2039_INT_PHY_NONE
	help
	  It is possible to use either MII or RMII to communicate with
	  the IC+101 Ethernet PHY mounted inside the STxH207. Use this
	  option to select the desired protocol. This must match the
	  jumper setting on the board:
			MII	RMII (ext clk)	RMII (no ext clk)
		 J30	remove	1-2		2-3
		 J37	1-2	2-3		remove
		 J38	remove	2-3		2-3
		 J39	1-2	2-3		2-3

config STM_B2039_IC101_MII
	bool "MII connection"

config STM_B2039_IC101_RMII_EXTCLK
	bool "RMII connection with external clock"

config STM_B2039_IC101_RMII_NO_EXTCLK
	depends on STM_B2039_INT_PHY_IC101A
	bool "RMII connection with no external clock"

endchoice

choice
	prompt "B2039: card selection on CN14 connector (Ethernet PHY)"
	default STM_B2039_CN14_NONE
	depends on STM_B2039_INT_PHY_NONE
	help
	  Select the appropriate Ethernet PHY card.
	  This controls the Ethernet connection mode with the PHY, and
	  the corrisponding pad allocation and configuration.

config STM_B2039_CN14_NONE
	bool "None"
	help
	  No Ethernet card is plugged into CN14 of the B2039.

config STM_B2039_CN14_B2032
	bool "B2032 IC+ IP1001 PHY card"
	help
	  B2032 Ethernet card on CN14 of B2039.

	  Note in order to continue using UART10 it will be necessary
	  to remove R256.

config STM_B2039_CN14_B2035
	bool "B2035 IC+ IP101 PHY card"
	help
	  B2035 connected to CN14 of B2039.

endchoice

config STM_B2039_J35_PHY_RESET
	bool "Use PIO3[0] as a PHY reset signal"
	default y
	help
	  Set this option to use PIO3[0] as a PHY reset signal. This requires
	  fitting J35 in position 1-2 (which prevents the use of this pin
	  as SBC_SYS_CLK_IN), and also disconnecting CN12 (which prevents
	  the use of UART11). This also conflicts with the keyscan and
	  PWM10 use of this pin.

endmenu

endif
```

## arch/sh/boards/mach-b2057/Kconfig
```kconfig
if SH_ST_B2057

menu "B2057: STxH207-HDK board options"

choice
	prompt "B2057: card selection on JP1 connector (Ethernet PHY)"
	default STM_B2057_JP1_NONE
	help
	  Select the appropriate Ethernet PHY card.
	  This controls the Ethernet connection mode with the PHY, and
	  the corrisponding pad allocation and configuration.

config STM_B2057_JP1_NONE
       bool "None"
       help
         No Ethernet card is plugged into JP1 of the B2057.

config STM_B2057_JP1_B2032
	bool "B2032 IC+ IP1001 PHY card"
	help
	  B2032 Ethernet card on JP1 of B2057.

config STM_B2057_JP1_B2035
	bool "B2035 IC+ IP101 PHY card"
	help
	  B2035 connected to JP1 of B2057.

endchoice

endmenu

endif
```

## arch/sh/boards/mach-b2064/Kconfig
```kconfig
if SH_ST_B2064

menu "B2064: STxH239-HDK board options"

choice
	prompt  "B2064: Reference Board Version selection"
	default SH_ST_B2064B_BOARD
	help
	  Select the appropriate version of the board which you will be using.
	  This controls which PIO ports will be used for PHY reset.

config SH_ST_B2064A_BOARD
	bool "B2064A Board"
	help
	  B2064A Board for CUT1.0

config SH_ST_B2064B_BOARD
	bool "B2064B Board"
	help
	  B2064B Board for CUT1.0

config SH_ST_B2064C_BOARD
	bool "B2064C Board"
	help
	  B2064C Board for CUT2.0
endchoice

endmenu

endif
```

## arch/sh/boards/mach-b2067/Kconfig
```kconfig
if SH_ST_B2067

menu "B2067: STxH238-HDK board options"

choice
	prompt  "B2067: Reference Board Version selection"
	default SH_ST_B2067B_BOARD
	help
	  Select the appropriate version of the board which you will be using.
	  This controls which PIO ports will be used for PHY reset.

config SH_ST_B2067A_BOARD
	bool "B2067A Board"
	help
	  B2067A Board for CUT1.0

config SH_ST_B2067B_BOARD
	bool "B2067B Board"
	help
	  B2067B Board for CUT1.0

config SH_ST_B2067C_BOARD
	bool "B2067C Board"
	help
	  B2067C Board for CUT2.0
endchoice

endmenu

endif
```

## arch/sh/boards/mach-hdk7108/Kconfig
```kconfig
if SH_ST_HDK7108

menu "hdk7108: STx7108 Reference board options"

config SH_ST_HDK7108_STMMAC0
	bool "Enable STMMAC 0"
	default n
	help
	  Enable STMMAC 0

config SH_ST_HDK7108_GMAC_RGMII_MODE
	bool "Use GMAC1 in RGMII mode"
	help
	  GMAC1 is the default device used on this board and it is
	  configured in GMII GTX mode.
	  This option is used to have it working in RGMII mode.
	  To support RGMII remove R29 and place it at R37.

choice
	prompt  "hdk7108 Reference Board Version selection"
	default SH_ST_HDK7108_VER2_BOARD
	help
	  Select the appropriate version of the board which you will be using.
	  This controls which SATA and PCIe ports will be configured.

config SH_ST_HDK7108_VER1_BOARD
	bool "HDK7108 Ver 1.0 Board"
	help
	  HDK7108 Ver 1.0 Board with 2 SATA's designed for CUT1.0

config SH_ST_HDK7108_VER2_BOARD
	bool "HDK7108 Ver 2.0 Board"
	help
	  HDK7108 Ver 2.0 Board with PCIe and 1 SATA's designed for CUT2.0

config SH_ST_HDK7108_VER2_1A_BOARD
	bool "HDK7108 Ver 2.1A Board"
	help
	  HDK7108 Ver 2.0 Board with 2 SATA's designed for CUT2.0

endchoice

config STM_HDK7108_MALI_OS_MEMORY_SIZE
	hex "Maximum Mali GPU OS memory size"
	default "0x5000000"
	help
	  Specify the size of memory which the Mali driver is allowed to allocate
	  from Linux kernel.

endmenu

endif
```

## drivers/char/lirc/Kconfig
```kconfig
# LIRC http://lirc.sf.net/
# Kernel patch by Flameeyes <dgp85@users.sf.net>
# Check for new patch at http://flameeyes.web.ctonet.it
#
# Thanks to Koos Vriezen <koos.vriezen@xs4all.nl> for the Homebrew support.
# Thanks to Jeff Clark <jeff@tmtrading.com> for support when I wasn't able
# to update it and for his patch (found at http://www.clarkmania.com/~jclark/
# Thanks to Bernhard Rosenkraenzer <bero@arklinux.org> for SMP patch.
# Thanks to Vince <fuzzy77@free.fr> for the temporary lirc_atiusb driver.
# Thanks to Paul Miller <pmiller9@users.sourceforge.net> for the new working
# lirc_atiusb driver.

menu "Linux InfraRed Controller"

config LIRC_SUPPORT
	tristate "Linux InfraRed Controller"

	config LIRC_MCEUSB
		tristate "MCE USB Driver"
		depends on LIRC_SUPPORT && USB
		help
		  USB Microsoft IR Transceiver driver

	config LIRC_MCEUSB2
		tristate "MCE USB Driver"
		depends on LIRC_SUPPORT && USB
		help
		  LIRC driver for the Philips eHome USB Infrared
		  Transciever and the Microsoft MCE 2005 Remote Control

	config LIRC_SERIAL
		tristate "Serial Driver"
		depends on LIRC_SUPPORT && SERIAL_8250

		choice
			prompt "Serial Receiver Type"
			depends on LIRC_SERIAL

			config LIRC_HOMEBREW
				bool "Homebrew"

			config LIRC_SERIAL_ANIMAX
				bool "Animax"

			config LIRC_SERIAL_IRDEO
				bool "IRdeo"

			config LIRC_SERIAL_IRDEO_REMOTE
				bool "IRdeo Remote"

			config LIRC_SERIAL_NSLU2
				bool "NSLU2"

			config LIRC_SERIAL_IGOR
				bool "Igor Ceska's variation"

		endchoice

		config LIRC_SERIAL_TRANSMITTER
			bool "With transmitter diode"
			depends on LIRC_SERIAL && !LIRC_SERIAL_ANIMAX

		config LIRC_SERIAL_SOFTCARRIER
			bool "With software carrier"
			depends on LIRC_SERIAL_TRANSMITTER

		choice
			prompt "Serial Port"
			depends on LIRC_SERIAL
			config LIRC_SERIAL_COM1
				bool "COM1 (0x3f8, 4)"
			config LIRC_SERIAL_COM2
				bool "COM2 (0x2f8, 3)"
			config LIRC_SERIAL_COM3
				bool "COM3 (0x3e8, 4)"
			config LIRC_SERIAL_COM4
				bool "COM4 (0x2e8, 3)"
			config LIRC_SERIAL_OTHER
				bool "Other (custom values)"
		endchoice

		config LIRC_PORT_SERIAL
			hex "I/O Port"
				default "0x3f8" if LIRC_SERIAL_COM1
				default "0x2f8" if LIRC_SERIAL_COM2
				default "0x3e8" if LIRC_SERIAL_COM3
				default "0x2e8" if LIRC_SERIAL_COM4
			depends on LIRC_SERIAL

		config LIRC_IRQ_SERIAL
			hex "IRQ"
				default "4" if LIRC_SERIAL_COM1 || LIRC_SERIAL_COM3
				default "3" if LIRC_SERIAL_COM2 || LIRC_SERIAL_COM4
			depends on LIRC_SERIAL

	config LIRC_SIR
		tristate "SIR Driver"
		depends on LIRC_SUPPORT

		config LIRC_ON_SA1100
			bool "LIRC driver for StrongARM SA1100 embedded microprocessor"
			depends on LIRC_SIR

		choice
			prompt "SIR Type"
			depends on LIRC_SIR && !LIRC_ON_SA1100

			config LIRC_SIR_IRDA
				bool "SIR IrDA (built-in IR ports)"

			config LIRC_SIR_TEKRAM
				bool "Tekram Irmate 210 (16x50 UART compatible serial port)"

			config LIRC_SIR_ACTISYS_ACT200L
				bool "Actisys Act200L SIR driver support"

		endchoice

		choice
			prompt "Serial Port"
			depends on LIRC_SIR
			config LIRC_SIR_COM1
				bool "COM1 (0x3f8, 4)"
			config LIRC_SIR_COM2
				bool "COM2 (0x2f8, 3)"
			config LIRC_SIR_COM3
				bool "COM3 (0x3e8, 4)"
			config LIRC_SIR_COM4
				bool "COM4 (0x2e8, 3)"
			config LIRC_SIR_OTHER
				bool "Other (custom values)"
		endchoice

		config LIRC_PORT_SIR
			hex "I/O Port"
				default "0x3f8" if LIRC_SIR_COM1
				default "0x2f8" if LIRC_SIR_COM2
				default "0x3e8" if LIRC_SIR_COM3
				default "0x2e8" if LIRC_SIR_COM4
			depends on LIRC_SIR

		config LIRC_IRQ_SIR
			hex "IRQ"
				default "4" if LIRC_SIR_COM1 || LIRC_SIR_COM3
				default "3" if LIRC_SIR_COM2 || LIRC_SIR_COM4
			depends on LIRC_SIR

        config LIRC_STM
                tristate "STM Lirc support"
                depends on LIRC_SUPPORT && CPU_SUBTYPE_ST40
		help
		  The IR and UHF are identical and independent, except
		  that the IRB receiver does not use the noise filter.
		  Not all ST platforms support both type of receivers.
		  IR RX is the default mode.

	        config LIRC_STM_UHF_SCD
		        bool "Start Code Detector - SCD"
			depends on LIRC_STM
			default y
			help
			  This causes the driver to use SCD on UHF RX mode.
			  The start code detector detects any programmable start
			  code on UHF RX input. It works on a time unit called
			  symbol time. One graphical example to understand how to
			  configure properly the code, code length and nominal time
			  values based on Remote Control signals train can be found in
			  drivers/char/lirc/lirc_stm.c driver.

	        config LIRC_STM_UHF_SCD_CODE
			hex "Code to be detected"
			default "0x3FFFC028"
			depends on LIRC_STM_UHF_SCD
			help
			  Default value for Futarque RC is 0x3FFFC028.

	        config LIRC_STM_UHF_SCD_LEN
			hex "Code length"
			default "0x1e"
			depends on LIRC_STM_UHF_SCD
			help
			  Default value for Futarque RC is 0x1e.

	        config LIRC_STM_UHF_SCD_NTIME
			hex "Nominal time for a symbol"
				default "0x1f4"
			depends on LIRC_STM_UHF_SCD
			help
			  Default value for Futarque RC is 0x1f4.

	config LIRC_STM_DEBUG
		depends on LIRC_STM
		bool "Lirc debug"
		default n
		help
		  Say yes if you want enable some debug printk information

	config LIRC_TTUSBIR
	        tristate "Technotrend USB IR Receiver"
	        depends on LIRC_SUPPORT && USB
	        help
	          Driver for the Technotrend USB IR Receiver

endmenu
```

## drivers/e2/Kconfig
```kconfig
#
# Enigma2 specific procfs device 
#

config E2_DRIVERS
	boolean
	default y if CPU_SUBTYPE_ST40
	default n

menu "Enigma2 specific device driver support"
        depends on E2_DRIVERS

config E2_PROCFS
        tristate "E2 proc file system support"
        default m
        depends on (CPU_SUBTYPE_STX7105 \
                || CPU_SUBTYPE_STX7111 )
        ---help---
          Enigma2 proc file system interface support for various set-top box models.

          To compile this driver as a module, choose M here: the
          module will be called e2_procfs.


endmenu
```

## drivers/oprofile/Kconfig
```kconfig
menu Profilers

config PROFILING
	bool "Profiling support (EXPERIMENTAL)"
	help
	  Say Y here to enable the extended profiling support mechanisms used
	  by profilers such as OProfile.

config OPROFILE
	tristate "OProfile system profiling (EXPERIMENTAL)"
	depends on PROFILING
	depends on HAVE_OPROFILE
	depends on TRACING_SUPPORT
	select TRACING
	select RING_BUFFER
	help
	  OProfile is a profiling system capable of profiling the
	  whole system, include the kernel, kernel modules, libraries,
	  and applications.

	  If unsure, say N.

config OPROFILE_IBS
	bool "OProfile AMD IBS support (EXPERIMENTAL)"
	default n
	depends on OPROFILE && SMP && X86
	help
          Instruction-Based Sampling (IBS) is a new profiling
          technique that provides rich, precise program performance
          information. IBS is introduced by AMD Family10h processors
          (AMD Opteron Quad-Core processor "Barcelona") to overcome
          the limitations of conventional performance counter
          sampling.

	  If unsure, say N.

config HAVE_OPROFILE
	bool

endmenu
```
