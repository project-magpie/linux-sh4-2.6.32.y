## drivers/stm/Kconfig
```kconfig
#
# STM specific device configuration
#

config STM_DRIVERS
	boolean
	default y if CPU_SUBTYPE_ST40
	default n

menu "STM specific devices"
        depends on STM_DRIVERS

config STM_PCI_EMISS
	bool "STMicroelectronics PCI controller"
	depends on PCI && (CPU_SUBTYPE_FLI75XX || CPU_SUBTYPE_STX5206 || \
			   CPU_SUBTYPE_STX7105 || CPU_SUBTYPE_STX7108 || \
			   CPU_SUBTYPE_STX7111)
	def_bool n
	select GENERIC_IOMAP
	---help---
	  This option adds support for the PCI controller found on some
	  STMicroelectronics SOCs.

# PCIe controller from synopsys, wrapped for HVD parts
config STM_PCIE
	bool "STMicroelectronics PCI express controller"
	depends on PCI && (CPU_SUBTYPE_STX7108 || CPU_SUBTYPE_FLI7510 || CPU_SUBTYPE_STXH205)
	def_bool n
	select ARCH_SUPPORTS_MSI
	---help---
	  This option adds support for the PCI express controller found on some
	  STMicroelectronics SOCs.

config STM_MIPHY
	def_bool n

config STM_MIPHY_TAP
	bool
	depends on STM_MIPHY
	default y if CPU_SUBTYPE_STX7105
	default y if CPU_SUBTYPE_STX7108
	default y if CPU_SUBTYPE_STX7141
	default y if CPU_SUBTYPE_STX7200
	default n

config STM_MIPHY_PCIE_MP
	bool
	depends on STM_MIPHY
	default y if CPU_SUBTYPE_STX7108
	default y if CPU_SUBTYPE_FLI75XX
	default y if CPU_SUBTYPE_STXH205
	default n

config STM_MIPHY_DUMMY
	bool
	depends on STM_MIPHY
	default y if (CPU_SUBTYPE_STX7100 || CPU_SUBTYPE_FLI75XX)
	default n

config STM_MIPHYA40X
	bool
	depends on STM_MIPHY
	default y if CPU_SUBTYPE_STXH205
	default n

config STM_MIPHY365X
	bool
	depends on STM_MIPHY
	default y if CPU_SUBTYPE_STX7105
	default y if CPU_SUBTYPE_STX7108
	default y if CPU_SUBTYPE_STX7141
	default y if CPU_SUBTYPE_STX7200
	default y if CPU_SUBTYPE_FLI75XX
	default n

config STPIO
	bool "Legacy stpio API"
	default n
	help
	  Select this option to enable the legacy stpio interface. No
	  code within the kernel uses this API, it is retained only for
	  drivers outside the kernel which might still need it.

config STM_DMA
	bool "STMicroelectronics DMA API"
	select SH_DMA_API
	select LIBELF_32
	default y
	---help---
	  Selecting this option will provide support for STMicroelectronics'
	  custom DMA API. This API provides support for data transfers of
	  various dimensions and complex linked list operations. In addition
	  to these free-running operations it also allows management of the
	  paced-transfer peripherals on recent STM parts.

	  If you have a device from STMicroelectronics, then say Y here.
	  Otherwise say N.

config STM_DMA_DEBUG
	bool "STMicroelectronics DMA Debug"
	depends on STM_DMA
	default n

config STM_COPROCESSOR_SUPPORT
	bool "STMicroelectronics coprocessor support"
	default y
	depends on (CPU_SUBTYPE_STX7100 || CPU_SUBTYPE_STX7105 \
		|| CPU_SUBTYPE_STX7111 || CPU_SUBTYPE_STX7141 \
		|| CPU_SUBTYPE_STX7200 || CPU_SUBTYPE_STX7108 \
		|| CPU_SUBTYPE_STX5206 \
		|| CPU_SUBTYPE_FLI75XX)
	---help---
        Many of the ST system-on-chip devices have multiple CPUs, where a
        master CPU running Linux has control over a number of slave CPUs,
        which are usually used to run dedicated algorithms.
        Enabling this option will add support to the Linux kernel to
        control these slave CPUs, reserve memory for them, and thus allow
        code to be downloaded onto them and executed.
        Adding in the command line the following string:
        coprocessor_mem=[offset]:size0[,size1][,size2]...
        where:
        offset defines where the co-processors region starts.
               It's an offset from ST40 RAM start.
        size{n} defines the region size for the n.th slave core (max 16M).

        Example: coprocessor_mem=32m:16m,16m

config STM_NUM_COPROCESSOR
	int
	depends on STM_COPROCESSOR_SUPPORT
	default 2 if CPU_SUBTYPE_STX7100
	default 2 if CPU_SUBTYPE_STX7105
	default 2 if CPU_SUBTYPE_STX7111
	default 2 if CPU_SUBTYPE_STX7141
	default 2 if CPU_SUBTYPE_STX5206
	default 4 if CPU_SUBTYPE_STX7200
	default 3 if CPU_SUBTYPE_STX7108
	default 3 if CPU_SUBTYPE_FLI75XX
	default 0

choice
	prompt "STM coprocessor loading strategy"
        depends on STM_COPROCESSOR_SUPPORT
        default STM_COPROCESSOR

config  STM_COPROCESSOR
	bool "STM coprocessor support"
	help
	  Select this option to enable support for the slave coprocessors
	  found on many ST system-on-chip devices.

config  STM_COPROCESSOR_FRMW
	bool "The new STM coprocessor firmware support "
	select FW_LOADER
	help
	  Select this option to enable support for the slave coprocessors
	  found on many ST system-on-chip devices.

endchoice

config  COPROCESSOR_DEBUG
        depends on STM_COPROCESSOR_SUPPORT
        bool "STM coprocessor debug"
        default n
        ---help---
        Enable this option to print out information about the slave CPUs
        addresses and operations you are using for coprocessor.



config STM_RNG
       bool "STM Random Number Generator Support"
       default y
       ---help---
         This option adds support for the hardware Random Number Generator
         (RNG) present on different STMicroelectronics SoCs.  It allows the
         RNG to feed /dev/random with entropy thereby ensuring real
         random numbers from this device.

         Without this option, /dev/random has little entropy and is not
         useful.  In fact, it may block for a long time while waiting for
         entropy.

         This option should always be enabled for relevant SoCs.

         This option can be used in conjunction with the /dev/hw_random
         driver found in the char drivers menu.

config STM_MALI
	depends on CPU_SUBTYPE_STX7108
	tristate "STM Mali GPU support"
	default n
	help
	  Enable this option to support Mali GPU Driver.

config STM_MALI_OS_MEMORY_SIZE
	depends on STM_MALI
	hex "Maximum Mali GPU OS memory size"
	default "0x5000000"
	help
	  Specify the size of memory which the Mali driver is allowed to allocate
	  from Linux kernel.
	  
config STM_MALI_DEBUG
	depends on STM_MALI
	bool "Enable debug tracing"
	default y
	---help---
	  Enable this option to enable debug trace messages on the console

config PMS
	bool "Power Management Scheme"
	default n
	depends on PM
	select PM_RUNTIME
	help
	  This option enables the STMicroelectronics Power Management
	  Scheme (PMS).

	  This is a kernel framework based around power profiles (pms_state),
	  where the designer can specify devices power states and the
	  clock frequency rates.
	  Moving the system between pms_states the user application can
	  tune the power consumption according with what the system is doing.

config PMS_CHECK_GROUP
	bool "PMS always checks the state group"
	depends on PMS
	default n
	help
	  Enable this option if the state group has to be controlled.
	  When a group of pms_states are enabled in the same time, this option
	  forces the PMS to check that there is no conflict inside the group
	  itself. In case of conflict the group is rejected.

config PMS_DEBUG
	bool "PMS debug"
	default n
	depends on PMS
	help
	  Enable this option to print out information about the PMS

config STM_LPM
	bool "STM Low Power Monitor"
	depends on CPU_SUBTYPE_STXH205 || CPU_SUBTYPE_STX7108
	select LIBELF_64
	default n
	help
	 Enable this option for Standby Controller support.

config STM_LPM_I2C
	bool "External SBC"
	depends on STM_LPM &&  CPU_SUBTYPE_STX7108
	default n
	help
	 Enable this option for Standby controller which is connected to SOC
	 with i2c interface.

config STM_LPM_MB
	bool "Internal SBC"
	depends on STM_LPM &&  CPU_SUBTYPE_STXH205
	default n
	help
	 Enable this option for Standby controller which are internal to SOC.

config STM_LPM_RD_MONITOR
	bool "STLPM Monitoring power key press on GPIO"
	depends on STM_LPM && CPU_SUBTYPE_STX7108
	default n
	help
	 This enable intercept GPIO (7108_RD signal on HDK7108 board) activity.
	 This GPIO is connected to HDK7108 board's front panel and controlled
	 by external SBC.
	 When user presses standby button on FP, SBC drive this PIO to low.
	 STLPM driver intercept this GPIO interrupt and export to user land.
	 Application can track powerkey in sysfs to check if power key on front panel
	 is pressed or not.

config STM_LPM_POWER_PIO
	hex "STM Low Power GPIO Power-on/off"
	depends on STM_LPM
	default "0x370"
	help
	  This option is to select power on PIO .
	  This information will be used by SBC to do power off SOC/board
	  Format is encoded as "0xnnpe" where:
		nn is GPIO port number;
		p is GPIO pin number;
		e is pio edge on which power will be off
		- 1 means pio high will do power off
		- 0 means pio low will do power off

config STM_LPM_DEBUG
	bool "STM Low Power Monitor debug"
	depends on STM_LPM
	default n
	help
	 Enable this option to print debug information.

config STM_PTI
	tristate "STMicroelectronics PTI (Programmable Transport Interface) support"
	default m
	depends on (CPU_SUBTYPE_STX7100 || CPU_SUBTYPE_STX7105 \
		|| CPU_SUBTYPE_STX7111 )
	---help---
        Many of the ST system-on-chip devices have a PTI programmable transport interface.
 	The PTI is responsible for DVB transport stream muxing and descrambling. This driver
 	only provides demuxing support and laks descrambling support.

config STM_SCI
        tristate "STMicroelectronics SCI Smartcard reader support"
	default m
	depends on (CPU_SUBTYPE_STX7100 || CPU_SUBTYPE_STX7105 \
		|| CPU_SUBTYPE_STX7111 )
        ---help---
          Smartcard reader interface for various set-top box models

          To compile this driver as a module, choose M here: the
          module will be called smartcard.

config STM_CEC
        tristate "STMicroelectronics HDMI CEC support"
	default n
	depends on (CPU_SUBTYPE_STX7105 \
		|| CPU_SUBTYPE_STX7111 )
        ---help---
          HDMI CEC interface support for various set-top box models

          To compile this driver as a module, choose M here: the
          module will be called cec.

config STM_STB_CPU_FREQ
        tristate "STMicroelectronics CPU Frequency adjustment support"
	default m
	depends on (STM_CPU_FREQ) && (CPU_SUBTYPE_STX7100 ||CPU_SUBTYPE_STX7105 \
		|| CPU_SUBTYPE_STX7111 )
        ---help---
          CPU frequency adjustment interface support for various set-top box models

          To compile this driver as a module, choose M here: the
          module will be called cpu_freq.

choice
        prompt "Select STMicroelectronics multimedia framework"
        depends on STM_COPROCESSOR_SUPPORT
        default PLAYER_191
        ---help---
        This selects player2 version. The player2 framework is build seperate from Kernel,
        but some drivers depend on the player2 version used so this becomes a config option.

config  PLAYER_131
        bool "Player2 version 131"
        ---help---
        This selects player2 version 131

config  PLAYER_179
        bool "Player2 version 179"
        ---help---
        This selects player2 version 179

config  PLAYER_191
        bool "Player2 version 191"
        ---help---
        This selects player2 version 179

endchoice




endmenu
```

## sound/soc/stm/Kconfig
```kconfig
config SND_STM
	tristate "STMicroelectronics SoCs support"
	depends on SND
	depends on CPU_SUBTYPE_STB7100 || CPU_SUBTYPE_STX7200
	select SND_PCM
	select STM_DMA
	help
	  Say Y here for ALSA support on the STx710x & STx7200 families.

	  To compile this driver as a module, choose M here: the module
	  will be called snd-stm.o
```
